## firmware/esp32-csi-mesh-node/main/Kconfig.projbuild
```kconfig
menu "CSI Mesh Node Configuration"

    config MESH_NODE_ID
        int "Node ID (1-254)"
        default 1
        range 1 254
        help
            Unique identifier for this sensor node. Used in the
            ADR-018 binary frame header. Node 0 is reserved for
            the gateway.

    config MESH_CHANNEL
        int "Mesh WiFi Channel (1-13)"
        default 6
        range 1 13
        help
            WiFi channel used by the ESP-MESH network.
            Must match the gateway and all other sensor nodes.

    config MESH_AP_MAX_CONNECTIONS
        int "Max mesh children per node"
        default 6
        range 1 10
        help
            Maximum number of child nodes that can connect to this
            node in the mesh tree (relay capacity).

    config MESH_MAX_LAYER
        int "Maximum mesh layers"
        default 6
        range 2 25
        help
            Maximum depth of the mesh tree topology.

    config MESH_ROUTER_SSID
        string "Router SSID"
        default "wifi-densepose"
        help
            SSID of the upstream travel router. Only the root node
            connects to it directly, but all nodes need this for
            mesh configuration.

    config MESH_ROUTER_PASSWORD
        string "Router Password"
        default ""
        help
            Password for the upstream travel router.

    config MESH_AP_PASSWORD
        string "Mesh AP Password"
        default "meshpassword"
        help
            Password for the mesh network internal AP connections.
            Must match all nodes in the mesh.

endmenu
```

## firmware/esp32-csi-mesh-node/sdkconfig.defaults
```kconfig
# Target: ESP32-S3
CONFIG_IDF_TARGET="esp32s3"

# WiFi
CONFIG_ESP_WIFI_MODE_STA=y

# ESP-MESH
CONFIG_MESH_ENABLE=y

# Use custom partition table for NVS
CONFIG_PARTITION_TABLE_CUSTOM=y
CONFIG_PARTITION_TABLE_CUSTOM_FILENAME="partitions.csv"

# Serial output
CONFIG_ESP_CONSOLE_UART_DEFAULT=y
CONFIG_ESP_CONSOLE_UART_BAUDRATE=115200

# FreeRTOS
CONFIG_FREERTOS_HZ=1000

# Increase main task stack for mesh + CSI operations
CONFIG_ESP_MAIN_TASK_STACK_SIZE=8192

# Logging
CONFIG_LOG_DEFAULT_LEVEL_INFO=y
CONFIG_LOG_DEFAULT_LEVEL=3

# CSI Mesh Node Kconfig defaults
CONFIG_MESH_NODE_ID=1
CONFIG_MESH_CHANNEL=6
CONFIG_MESH_AP_MAX_CONNECTIONS=6
CONFIG_MESH_MAX_LAYER=6
CONFIG_MESH_ROUTER_SSID="wifi-densepose"
CONFIG_MESH_ROUTER_PASSWORD=""
CONFIG_MESH_AP_PASSWORD="meshpassword"
```

## firmware/esp32-mesh-gateway/main/Kconfig.projbuild
```kconfig
menu "Mesh Gateway Configuration"

    config MESH_CHANNEL
        int "Mesh WiFi Channel (1-13)"
        default 6
        range 1 13
        help
            WiFi channel used by the ESP-MESH network.
            All nodes (gateway + sensors) must use the same channel.

    config MESH_AP_MAX_CONNECTIONS
        int "Max mesh children per node"
        default 6
        range 1 10
        help
            Maximum number of child nodes that can connect to this
            node in the mesh tree.

    config MESH_MAX_LAYER
        int "Maximum mesh layers"
        default 6
        range 2 25
        help
            Maximum depth of the mesh tree topology.

    config MESH_ROUTER_SSID
        string "Router SSID"
        default "wifi-densepose"
        help
            SSID of the upstream travel router that the gateway
            connects to for IP connectivity.

    config MESH_ROUTER_PASSWORD
        string "Router Password"
        default ""
        help
            Password for the upstream travel router.

    config MESH_AP_PASSWORD
        string "Mesh AP Password"
        default "meshpassword"
        help
            Password for the mesh network internal AP connections.

    config MESH_AGGREGATOR_IP
        string "Aggregator IP"
        default "192.168.8.100"
        help
            IP address of the CSI aggregator (Steam Deck).

    config MESH_AGGREGATOR_PORT
        int "Aggregator UDP Port"
        default 5005
        range 1024 65535
        help
            UDP port the CSI aggregator listens on.

endmenu
```

## firmware/esp32-mesh-gateway/sdkconfig.defaults
```kconfig
# Target: ESP32-S3
CONFIG_IDF_TARGET="esp32s3"

# WiFi
CONFIG_ESP_WIFI_MODE_STA=y

# ESP-MESH
CONFIG_MESH_ENABLE=y

# Use custom partition table for NVS
CONFIG_PARTITION_TABLE_CUSTOM=y
CONFIG_PARTITION_TABLE_CUSTOM_FILENAME="partitions.csv"

# Serial output
CONFIG_ESP_CONSOLE_UART_DEFAULT=y
CONFIG_ESP_CONSOLE_UART_BAUDRATE=115200

# FreeRTOS
CONFIG_FREERTOS_HZ=1000

# Increase main task stack for mesh operations
CONFIG_ESP_MAIN_TASK_STACK_SIZE=8192

# Logging
CONFIG_LOG_DEFAULT_LEVEL_INFO=y
CONFIG_LOG_DEFAULT_LEVEL=3

# Mesh gateway Kconfig defaults
CONFIG_MESH_CHANNEL=6
CONFIG_MESH_AP_MAX_CONNECTIONS=6
CONFIG_MESH_MAX_LAYER=6
CONFIG_MESH_ROUTER_SSID="wifi-densepose"
CONFIG_MESH_ROUTER_PASSWORD=""
CONFIG_MESH_AP_PASSWORD="meshpassword"
CONFIG_MESH_AGGREGATOR_IP="192.168.8.100"
CONFIG_MESH_AGGREGATOR_PORT=5005
```
